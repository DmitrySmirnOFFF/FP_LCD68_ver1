; ************ Примечания *****************************************************
; Этот ЖК-модуль я долго не мог запустить. Спасибо некоторым за корявые примеры
; программ.
; При включении питания триггеры ЖК-модуля принимают неопределенное состояние.
; На экране это видится как китайская грамота.
; Я не смог найти команду очистки экрана, пришлось после инициализации
; ЖК-модуля забивать символом пробела для очистки экрана. Так как у этого 
; ЖК-модуля области текста и графики раздельные, то соответственно пришлось
; забивать пробелом обе области.
; Микрокотроллер ATMEGA8535
; ЖК-модуль WG12864D на контроллере Toshiba T6963C
; *****************************************************************************

.NOLIST
.INCLUDE "m8535def.inc"
.LIST

.EQU RST =0
.EQU CE =1
.EQU CD =2
.EQU WR =3
.EQU RD =4
.EQU FS =5
.EQU SD2 =0 ; Флаг передачи 2 байтов данных (Send Data 2)

.EQU TXHOME =0x40 ; Задать адрес начала текста
.EQU TXAREA =0x41 ; Задать текстовую область
.EQU GRHOME =0x42 ; Задать адрес начала графики
.EQU GRAREA =0x43 ; Задать графическую область
.EQU OFFSET =0x22 ; Задать адрес смещения
.EQU ADPSET =0x24 ; Задать указатель адреса
.EQU AWRON =0xB0 ; Установить режим автоматической записи
.EQU AWROFF =0xB2 ; Отключить режим автоматической записи

.DEF Flags =r12
.DEF Cnt =r13
.DEF Time_1 =r14
.DEF Time_2 =r15
.DEF Temp =r16
.DEF CMDR =r17
.DEF CPR =r18
.DEF DataL =r20
.DEF DataH =r21

.cseg

rjmp Initial
reti
reti
reti
reti
reti
reti
reti
reti
reti
reti
reti
reti
reti
reti
reti
reti
reti
reti
reti
reti

; ************ Сброс ЖК при включении питания *********************************

RstLCD:
cbi PortA,RST
ldi temp,100
mov Cnt,temp
RLCD:
dec Cnt
brne RLCD
sbi PortA,RST
ret

; ************ Передача команды ***********************************************

SendCom:
ser Temp
out DDRC,Temp
out PortC,CMDR
ldi Temp,0xD5
out PortA,Temp
nop
nop
nop
nop
sbi PortA,CE
clr Temp
out DDRC,Temp
out PortC,Temp
ret

; ************ Передача данных ************************************************

SendDat:
ser Temp
out DDRC,Temp
out PortC,DataL
ldi Temp,0xD1
out PortA,Temp
nop
nop
nop
nop
sbi PortA,CE
sbrs Flags,SD2 ; Если установлен этот флаг, то передача двух байтов
ret
rcall WaitBusy
ser Temp
out DDRC,Temp
out PortC,DataH
ldi Temp,0xD1
out PortA,Temp
nop
nop
nop
nop
sbi PortA,CE
mov temp,Flags
cbr temp,1<<SD2
mov Flags,temp
clr Temp
out DDRC,Temp
out PortC,Temp
ret

; ************ Чтение статуса *************************************************

WaitBusy:
clr Temp
out DDRC,Temp
WB1:
ldi Temp,0xCD
out PortA,Temp
nop
nop
nop
nop
in Temp,PinC
sbi PortA,CE
and Temp,CPR
cp Temp,CPR
brne WB1
ret

; ************ Вывод массива текста, графики **********************************

OutText:
lsl ZL
rol ZH
OT1:
lpm
mov DataL,r0
rcall WaitBusy
rcall SendDat
adiw ZL,1
sbiw XL,1
brne OT1
ret

Wait_50_us:
ldi temp,164
mov time_1,temp
W50us:
dec time_1
brne W50us
ret

Wait_150_us:
rcall Wait_50_us
rcall Wait_50_us
rcall Wait_50_us
ret

Wait_5_ms:
ldi temp,100
mov time_2,temp
W5ms:
rcall Wait_50_us
dec time_2
brne W5ms
ret

Wait_100_ms:
ldi temp,20
mov cnt,temp
W100ms:
rcall Wait_5_ms
dec cnt
brne W100ms
ret

Wait_500_ms:
rcall Wait_100_ms
rcall Wait_100_ms
rcall Wait_100_ms
rcall Wait_100_ms
rcall Wait_100_ms
ret

Wait_1_s:
ldi temp,200
mov cnt,temp
W1s:
rcall Wait_5_ms
dec cnt
brne W1s
ret

; ************ Вывод текстовой строки *************************************

Out_Stroka:
mov temp,Flags ; Если установлен этот флаг, то передача двух байтов
sbr temp,1<<SD2
mov Flags,temp
ldi CPR,0x03
rcall WaitBusy
rcall SendDat

ldi CMDR,ADPSET
ldi CPR,0x03
rcall WaitBusy
rcall SendCom

ldi CMDR,AWRON ; Установить режим автозаписи данных
ldi CPR,0x03
rcall WaitBusy
rcall SendCom

clr DataH
mov DataL,r6
ldi CPR,0x08
C1:
rcall WaitBusy
rcall SendDat
sbiw XL,1
brne C1

ldi CMDR,AWROFF ; Отключить режим автозаписи данных
ldi CPR,0x03
rcall WaitBusy
rcall SendCom
ret

; ************ Вывод массива **************************************************

Out_Massiv:
mov temp,Flags ; Если установлен этот флаг, то передача двух байтов
sbr temp,1<<SD2
mov Flags,temp
ldi CPR,0x03
rcall WaitBusy
rcall SendDat

ldi CMDR,ADPSET
ldi CPR,0x03
rcall WaitBusy
rcall SendCom

ldi CMDR,AWRON ; Установить режим автозаписи данных
ldi CPR,0x03
rcall WaitBusy
rcall SendCom
ldi CPR,0x08
rcall OutText

ldi CMDR,AWROFF ; Отключить режим автозаписи данных
ldi CPR,0x03
rcall WaitBusy
rcall SendCom
ret

; ************ Рисуем прямую линию *******************************************

Line_2:
movw DataL,XL
mov temp,Flags ; Если установлен этот флаг, то передача двух байтов
sbr temp,1<<SD2
mov Flags,temp
ldi CPR,0x03
rcall WaitBusy
rcall SendDat
ldi CMDR,ADPSET
ldi CPR,0x03
rcall WaitBusy
rcall SendCom
mov DataL,r6
ldi CPR,0x03
rcall WaitBusy
rcall SendDat
ldi CMDR,0xC4 ; Записать Данные и не изменять УА
ldi CPR,0x03
rcall WaitBusy
rcall SendCom
adiw XL,1
inc r2
cp r2,r4
cpc r3,r5
brne Line_2
ret

Initial:
ldi temp,High(RamEnd) ; Инициализация стека
out sph,temp
ldi temp,Low(RamEnd)
out spl,temp
clr Flags ; Очистка регистра флагов.
ser Temp
out DDRA,Temp
out PortA,Temp ; Порт A - Линии управления ЖК
;cbi PortA,FS

; ************ Сброс ЖК при включении питания *********************************

Start:
rcall RstLCD

; ************ Задать адрес начала текста *************************************

ldi DataH,High(0x0780)
ldi DataL,Low(0x0780)
mov temp,Flags ; Если установлен этот флаг, то передача двух байтов
sbr temp,1<<SD2
mov Flags,temp
ldi CPR,0x03
rcall WaitBusy
rcall SendDat

ldi CMDR,TXHOME
ldi CPR,0x03
rcall WaitBusy
rcall SendCom

; ************ Задать адрес начала графики ************************************

clr DataH
clr DataL
mov temp,Flags ; Если установлен этот флаг, то передача двух байтов
sbr temp,1<<SD2
mov Flags,temp
ldi CPR,0x03
rcall WaitBusy
rcall SendDat

ldi CMDR,GRHOME
ldi CPR,0x03
rcall WaitBusy
rcall SendCom

; ************ Задать текстовую область ***************************************

clr DataH
ldi DataL,128/8
mov temp,Flags ; Если установлен этот флаг, то передача двух байтов
sbr temp,1<<SD2
mov Flags,temp
ldi CPR,0x03
rcall WaitBusy
rcall SendDat

ldi CMDR,TXAREA
ldi CPR,0x03
rcall WaitBusy
rcall SendCom

; ************ Задать область графики *****************************************

clr DataH
ldi DataL,128/8
mov temp,Flags ; Если установлен этот флаг, то передача двух байтов
sbr temp,1<<SD2
mov Flags,temp
ldi CPR,0x03
rcall WaitBusy
rcall SendDat

ldi CMDR,GRAREA
ldi CPR,0x03
rcall WaitBusy
rcall SendCom

; ************ УСТАНОВКА РЕЖИМА (OR РЕЖИМ) ************************************

ldi CMDR,0x80
ldi CPR,0x03
rcall WaitBusy
rcall SendCom

; ************ Установка режима отображения ***********************************

ldi CMDR,0x9C ; Режим отображения (текст вкл., графика вкл.)
ldi CPR,0x03
rcall WaitBusy
rcall SendCom

; ************ Очистка текстового экрана (записать код пробела) ***************

ldi DataH,High(0x0780)
ldi DataL,Low(0x0780)
clr r6
ldi XH,High(128)
ldi XL,Low(128)
rcall Out_Stroka

; ************ Очистить графический экран (записать код пробела) **************

clr DataH
clr DataL
clr r6
ldi XH,High(1024)
ldi XL,Low(1024)
rcall Out_Stroka

; ************ Рисуем диагональную линию **************************************

Line_1:
clr r2
clr r3
clr r7
clr XH
clr XL
ldi temp,16
mov r2,temp
L_11:
ldi temp,0x80
mov r6,temp
L_12:
mul r2,r3
add r0,r7
movw DataL,r0
mov temp,Flags ; Если установлен этот флаг, то передача двух байтов
sbr temp,1<<SD2
mov Flags,temp
ldi CPR,0x03
rcall WaitBusy
rcall SendDat
ldi CMDR,ADPSET
ldi CPR,0x03
rcall WaitBusy
rcall SendCom
mov DataL,r6
ldi CPR,0x03
rcall WaitBusy
rcall SendDat
ldi CMDR,0xC4 ; Записать Данные и не изменять УА
ldi CPR,0x03
rcall WaitBusy
rcall SendCom
inc r3
mov temp,r3
cpi temp,64
breq Paint_Line_H
lsr r6
in temp,SREG
sbrs temp,0
rjmp L_12
inc r7
rjmp L_11

Paint_Line_H:
clr r2
clr r3
clr XH
clr XL
ser temp
mov r6,temp
clr r5
ldi temp,16
mov r4,temp
rcall Line_2

Paint_Line_L:
clr r2
clr r3
ldi XH,High(1024-16)
ldi XL,Low(1024-16)
ser temp
mov r6,temp
clr r5
ldi temp,16
mov r4,temp
rcall Line_2

; ************ Вывод тескта на экран ******************************************

ldi DataH,High(0x07B1) ; Задать адрес начала текста
ldi DataL,Low(0x07B1)
ldi ZH,High(Text)
ldi ZL,Low(Text)
ldi XH,High(13)
ldi XL,Low(13)
rcall Out_Massiv

rjmp Nul

; ************ Вывести картинку на экран **************************************

;Out_Grafika:
;clr DataH
;clr DataL
;sbr Flags,1<<SD2 ; Установка флага передачи двух байтов.
;ldi CPR,0x03
;rcall WaitBusy
;rcall SendDat

;ldi CMDR,ADPSET
;ldi CPR,0x03
;rcall WaitBusy
;rcall SendCom

;ldi CMDR,AWRON ; Установить Автозапись данных
;ldi CPR,0x03
;rcall WaitBusy
;rcall SendCom

;ldi ZH,High(Grafika)
;ldi ZL,Low(Grafika)
;ldi XH,High(1024)
;ldi XL,Low(1024)
;ldi CPR,0x08
;rcall OutText

;ldi CMDR,AWROFF
;ldi CPR,0x03
;rcall WaitBusy
;rcall SendCom

Nul:
rjmp Nul

.ORG 0x400

Text:
.DB 0x34,0x00,0x2F,0x00,0x33,0x00,0x28,0x00,0x29,0x00,0x22,0x00,0x21

Grafika:
.DB 0xFF, 0x85, 0xFF, 0xFE, 0x80, 0x00, 0x00, 0x00
.DB 0x00, 0x0D, 0xF4, 0x00, 0x00, 0x00, 0x00, 0x00
.DB 0xFF, 0x87, 0xFF, 0xF6, 0x80, 0x00, 0x00, 0x00
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.DB 0xD7, 0xFF, 0x50, 0x00, 0x00, 0x00, 0x00, 0x00
